// SPDX-License-Identifier: GPL-2.0-or-later
/* Reuse the peripheral shim and real selection parser from the existing suite.
 * Only the host fixture entry point is renamed. Production callback/IRQ bodies
 * are included unchanged from files generated by the Python runner. */
#define main existing_test_main
#include "test_anticollision.c"
#undef main

enum {
    NRFX_NFCT_EVT_FIELD_DETECTED, NRFX_NFCT_EVT_FIELD_LOST,
    NRFX_NFCT_EVT_TX_FRAMESTART, NRFX_NFCT_EVT_TX_FRAMEEND,
    NRFX_NFCT_EVT_RX_FRAMEEND, NRFX_NFCT_EVT_ERROR, NRFX_NFCT_EVT_SELECTED
};
enum { NRFX_NFCT_ERROR_FRAMEDELAYTIMEOUT, NRFX_NFCT_ERROR_NUM };
enum {
    NRF_NFCT_EVENT_FIELDDETECTED, NRF_NFCT_EVENT_FIELDLOST,
    NRF_NFCT_EVENT_RXFRAMESTART, NRF_NFCT_EVENT_RXFRAMEEND,
    NRF_NFCT_EVENT_RXERROR, NRF_NFCT_EVENT_SELECTED,
    NRF_NFCT_EVENT_ERROR, NRF_NFCT_EVENT_TXFRAMESTART,
    NRF_NFCT_EVENT_TXFRAMEEND, TEST_EVENT_COUNT
};
typedef struct { uint8_t *p_data; uint32_t data_size; } mock_data_t;
typedef struct {
    int evt_id;
    union {
        struct { uint32_t rx_status; mock_data_t rx_data; } rx_frameend;
        struct { mock_data_t tx_data; } tx_framestart;
        struct { int reason; } error;
    } params;
} nrfx_nfct_evt_t;
typedef enum {
    NRFX_NFC_FIELD_STATE_NONE, NRFX_NFC_FIELD_STATE_ON,
    NRFX_NFC_FIELD_STATE_OFF, NRFX_NFC_FIELD_STATE_UNKNOWN
} nrfx_nfct_field_state_t;

static bool events[TEST_EVENT_COUNT];
static unsigned error_status;
static unsigned error_status_reads[16];
static unsigned error_status_read_count;
static unsigned stop_tx_count;
static unsigned rearm_count;
static char callback_order[16];
static unsigned callback_steps;
static bool inject_timeout_during_rx;
bool g_usb_led_marquee_enable, g_is_tag_emulating;

#define NRF_LOG_ERROR(...)
#define NRFX_LOG_DEBUG(...)
#define RGB_GREEN 1
#define TAG_FIELD_LED_ON() (void)0;
#define TAG_FIELD_LED_OFF() (void)0;
#define SLEEP_DELAY_MS_FIELD_NFC_LOST 3000
#define NRFX_NFCT_STATE_ACTIVATED 1
#define NRFX_NFCT_FRAME_STATUS_RX_ALL_MASK 0xff
#define NRFX_NFCT_ERROR_STATUS_ALL_MASK 0xff
#define NRF_NFCT_ERROR_FRAMEDELAYTIMEOUT_MASK 1
#define NRFX_NFCT_TX_INT_MASK 0xff
#define NRFX_NFCT_BITS_TO_BYTES(bits) ((bits) / 8)
#define NRFX_NFCT_EVT_ACTIVE(name) (events[NRF_NFCT_EVENT_ ## name])
#undef NRFX_NFCT_RX_BYTES
#define NRFX_NFCT_RX_BYTES do { rearm_count++; } while (0);

static void nfc_fdt_reset(void) {
    stop_tx_count++;
    test_nfct.TASKS_STARTTX = 0;
    test_nfct.FRAMEDELAYMAX = 4096;
}
static void __attribute__((unused)) sleep_timer_stop(void) {}
static void sleep_timer_start(unsigned n) { (void)n; }
static void set_slot_light_color(unsigned n) { (void)n; }
static void __attribute__((unused)) nrfx_nfct_autocolres_disable(void) {}
static void __attribute__((unused)) nrfx_nfct_state_force(unsigned n) { (void)n; }
/* Clock lifecycle has its own suite; this suite checks IRQ notification order. */
static void __attribute__((unused)) nfc_tag_14a_field_start(void) {}
static void __attribute__((unused)) nfc_tag_14a_field_stop(void) {}
static void nrf_nfct_reset(void) {}
static void nrfx_nfct_field_event_handler(nrfx_nfct_field_state_t state) {
    assert(state == NRFX_NFC_FIELD_STATE_ON);
    assert(callback_steps < sizeof(callback_order));
    callback_order[callback_steps++] = 'F';
}
static void nrf_nfct_event_clear(unsigned n) { events[n] = false; }
static uint8_t *nrf_nfct_rxtx_buffer_get(void) { return m_nfc_rx_buffer; }
static unsigned nrf_nfct_rx_bits_get(bool n) { (void)n; return test_nfct.RXD.AMOUNT; }
static unsigned nrf_nfct_tx_bits_get(void) { return test_nfct.TXD.AMOUNT; }
static unsigned nrf_nfct_rx_frame_status_get(void) { return 0; }
static void nrf_nfct_rx_frame_status_clear(unsigned n) { (void)n; }
static void nrfx_nfct_frame_delay_max_set(bool n) { (void)n; }
static unsigned nrf_nfct_error_status_get(void) {
    assert(error_status_read_count < sizeof(error_status_reads) / sizeof(error_status_reads[0]));
    error_status_reads[error_status_read_count++] = error_status;
    return error_status;
}
static void nrf_nfct_error_status_clear(unsigned n) { error_status &= ~n; }
static void nrf_nfct_int_disable(unsigned n) { (void)n; }
void nfc_tag_14a_event_callback(nrfx_nfct_evt_t const *event);
static struct { struct { void (*cb)(nrfx_nfct_evt_t const *); } config; } m_nfct_cb = {
    .config.cb = nfc_tag_14a_event_callback
};
static void deliver(void (*cb)(nrfx_nfct_evt_t const *), nrfx_nfct_evt_t const *event) {
    assert(callback_steps < sizeof(callback_order));
    callback_order[callback_steps++] = event->evt_id == NRFX_NFCT_EVT_RX_FRAMEEND ? 'R' :
                                     event->evt_id == NRFX_NFCT_EVT_ERROR ? 'E' : 'X';
    cb(event);
    if (inject_timeout_during_rx && event->evt_id == NRFX_NFCT_EVT_RX_FRAMEEND) {
        inject_timeout_during_rx = false;
        events[NRF_NFCT_EVENT_ERROR] = true;
        error_status |= NRF_NFCT_ERROR_FRAMEDELAYTIMEOUT_MASK;
    }
}
#define NRFX_NFCT_CB_HANDLE(cb, event) deliver((cb), &(event))

#include "nfct_event_callback.inc"
#include "nfct_irq_handler.inc"

static void start_fixture(void) {
    setup(7);
    m_tag_state_14a = NFC_TAG_STATE_14A_IDLE;
    memset(events, 0, sizeof(events));
    error_status = stop_tx_count = rearm_count = callback_steps = 0;
    error_status_read_count = 0;
    inject_timeout_during_rx = false;
    memset(callback_order, 0, sizeof(callback_order));
}
static void pend_req_a(void) {
    uint8_t encoded[300];
    uint8_t req_a = 0x26;
    unsigned bits = encode(&req_a, 7, encoded);
    memcpy(m_nfc_rx_buffer, encoded, (bits + 7) / 8);
    test_nfct.RXD.AMOUNT = bits;
    events[NRF_NFCT_EVENT_RXFRAMEEND] = true;
}
static void pend_timeout(void) {
    events[NRF_NFCT_EVENT_ERROR] = true;
    error_status |= NRF_NFCT_ERROR_FRAMEDELAYTIMEOUT_MASK;
}
static void expect_atqa(void) {
    assert(m_tag_state_14a == NFC_TAG_STATE_14A_READY);
    assert(m_selection_timing_active && test_nfct.TASKS_STARTTX);
    assert(test_nfct.TXD.AMOUNT == 16 && memcmp(m_nfc_tx_buffer, profile.atqa, 2) == 0);
    assert(stop_tx_count == 0 && rearm_count == 0);
}
static void expect_recovered(void) {
    assert(m_tag_state_14a == NFC_TAG_STATE_14A_IDLE);
    assert(!m_selection_timing_active && !test_nfct.TASKS_STARTTX);
    assert(stop_tx_count == 1 && rearm_count == 1);
}
int main(int argc, char **argv) {
    assert(argc == 2);
    start_fixture();
    if (!strcmp(argv[1], "reqa_without_error")) {
        pend_req_a();
        nrfx_nfct_irq_handler();
        expect_atqa();
        assert(callback_steps == 1 && callback_order[0] == 'R');
    } else if (!strcmp(argv[1], "stale_timeout_before_new_req_a")) {
        pend_timeout();
        pend_req_a();
        nrfx_nfct_irq_handler();
        expect_atqa();
        assert(callback_steps == 2 && memcmp(callback_order, "ER", 2) == 0);
        assert(error_status == 0 && !events[NRF_NFCT_EVENT_ERROR]);
    } else if (!strcmp(argv[1], "genuine_timeout_after_new_req_a")) {
        pend_req_a();
        nrfx_nfct_irq_handler();
        expect_atqa();
        pend_timeout();
        nrfx_nfct_irq_handler();
        expect_recovered();
        assert(callback_steps == 2 && memcmp(callback_order, "RE", 2) == 0);
    } else if (!strcmp(argv[1], "stale_then_genuine_timeout_during_rx")) {
        pend_timeout();
        pend_req_a();
        inject_timeout_during_rx = true;
        nrfx_nfct_irq_handler();
        expect_recovered();
        assert(callback_steps == 3 && memcmp(callback_order, "ERE", 3) == 0);
        assert(error_status == 0 && !events[NRF_NFCT_EVENT_ERROR]);
    } else if (!strcmp(argv[1], "selected_preserves_error_suppression")) {
        pend_timeout();
        pend_req_a();
        events[NRF_NFCT_EVENT_SELECTED] = true;
        nrfx_nfct_irq_handler();
        expect_atqa();
        assert(callback_steps == 2 && memcmp(callback_order, "RX", 2) == 0);
        assert(error_status == 0 && !events[NRF_NFCT_EVENT_ERROR]);
    } else if (!strcmp(argv[1], "field_events_still_precede_error_and_rx")) {
        events[NRF_NFCT_EVENT_FIELDDETECTED] = true;
        pend_timeout();
        pend_req_a();
        nrfx_nfct_irq_handler();
        expect_atqa();
        assert(callback_steps == 3 && memcmp(callback_order, "FER", 3) == 0);
    } else if (!strcmp(argv[1], "other_errors_keep_existing_handling")) {
        events[NRF_NFCT_EVENT_ERROR] = true;
        error_status = 2; /* A non-FDT status bit. */
        pend_req_a();
        nrfx_nfct_irq_handler();
        expect_atqa();
        assert(callback_steps == 1 && callback_order[0] == 'R');
        assert(error_status == 0 && !events[NRF_NFCT_EVENT_ERROR]);
    } else if (!strcmp(argv[1], "mixed_error_bits_are_preserved")) {
        pend_timeout();
        error_status |= 2;
        pend_req_a();
        nrfx_nfct_irq_handler();
        expect_atqa();
        assert(callback_steps == 2 && memcmp(callback_order, "ER", 2) == 0);
        // The early path clears only FDT; the normal path still sees bit 2.
        assert(error_status_read_count == 2);
        assert(error_status_reads[0] == 3 && error_status_reads[1] == 2);
        assert(error_status == 0 && !events[NRF_NFCT_EVENT_ERROR]);
    } else {
        return 2;
    }
    return 0;
}

